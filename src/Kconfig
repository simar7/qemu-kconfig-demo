## src/Kconfig
```kconfig
# Kconfig QEMU configuration

mainmenu "QEMU Configuration (DEMO)"

menu "Target(s)"

    config linux
        bool "linux"
        help
            Build for linux.
    
    config softmmu
        bool "softmmu"
        help
            Build with softmmu option enabled.
    config bsd
        bool "bsd"
        help
            Build for BSD.
endmenu

menu "Architecture(s)"
    
    config x86
        bool "x86"
        depends on softmmu || bsd || linux
        help
            Configure as an x86 target.

    config ARM
        bool "ARM"
        depends on linux || softmmu
        help
            Configure as an ARM target.

    config Alpha
       bool "Alpha"
       depends on linux || softmmu
       help
            Configure as an Alpha target.
    
    config Cris 
       bool "Cris"
       depends on linux || softmmu
       help
            Configure as a Cris target.

    config i386
       bool "i386"
       depends on linux || bsd || softmmu
       help
            Configure as an i386 target.

    config lm32
       bool "lm32"
       depends on softmmu
       help
            Configure as a lm32 target.

    config m68k
       bool "m68k"
       depends on linux || softmmu
       help
            Configure as a m68k target.

    config microblazeel 
        bool "microblazeel"
        depends on linux || softmmu
        help
            Configure as a microblaze-el target.

    config microblaze
       bool "microblaze"
       depends on linux || softmmu
       help
            Configure as a microblaze target.

    config mips64el
       bool "mips64el"
       depends on linux || softmmu
       help
            Configure as a mips64-el target.

    config mips64
       bool "mips64"
       depends on linux || softmmu 
       help
            Configure as a mips64 target.

    config mipsel
       bool "mipsel"
       depends on linux || softmmu
       help
            Configure as a mips-el target.

    config mips
       bool "mips"
       depends on softmmu
       help
            Configure as a mips target.

    config mipsn32el
       bool "mipsn32el"
       depends on linux
       help
            Configure as a mipsn32-el target.

    config mipsn32
       bool "mipsn32"
       depends on linux
       help
            Configure as a mipsn32 target.

    config moxie
       bool "moxie"
       depends on softmmu
       help
            Configure as a moxie target.

    config or32 
       bool "or32"
       depends on linux || softmmu
       help
            Configure as a or32 target.

    config ppc64abi32
       bool "ppc64abi32"
       depends on linux
       help
            Configure as a ppc64-abi32 target.

    config ppc64
       bool "ppc64"
       depends on linux || softmmu
       help
            Configure as a ppc64 target.

    config ppcemb
       bool "ppcemb"
       depends on softmmu
       help
            Configure as a ppcemb target.

    config ppc
       bool "ppc"
       depends on linux || softmmu
       help
            Configure as a ppc target.

    config s390x
       bool "s390x"
       depends on linux || softmmu
       help
            Configure as a s390x target.

    config sh4eb
       bool "sh4eb"
       depends on linux || softmmu
       help
            Configure as a sh4eb target.

    config sh4
       bool "sh4"
       depends on softmmu
       help
            Configure as a sh4 target.

    config sparc32plus
       bool "sparc32plus"
       depends on linux
       help
            Configure as a sparc32-plus target.

    config sparc64
       bool "sparc64"
       depends on bsd || linux || softmmu
       help
            Configure as a sparc64 target.

    config sparc
       bool "sparc"
       depends on bsd || linux || softmmu
       help
            Configure as a sparc target.

    config unicore32
       bool "unicore32"
       depends on linux || softmmu
       help
            Configure as an unicore32 target.

    config xtensaeb
       bool "xtensaeb"
       depends on softmmu
       help
            Configure as an xtensaeb target.

    config xtensa
       bool "xtensa"
       depends on softmmu
       help
            Configure as a xtensa target.

endmenu

menu "Machine(s) - (currently only for i386)"
    
    config Standard_PC
        bool "Standard PC"
        depends on i386
        select pc-i440fx-1.4
        select pc-i440fx-1.5
        select pc-1.3
        select pc-1.2
        select pc-1.1
        select pc-1.0
        select pc-0.15
        select pc-0.14
        select pc-0.13
        select pc-0.12
        select pc-0.11
        select pc-0.10
        select isapc
        select pc-q35-1.5
        select pc-q35-1.4
        
        help
            Enables all machines on i386.

    config StandardPC_i440FX
        bool "Standard PC (i440FX + PIIX, 1996) only"
        depends on i386
        default y
        select pc-i440fx-1.5
        select pc-i440fx-1.4
        help
            Enables only (i440FX + PIIX, 1996) ver 1.4 and 1.5 on i386.

    config StandardPC_Q35
        bool "Standard PC (Q35 + ICH9, 2009)"
        depends on i386
        select pc-q35-1.5
        select pc-q35-1.4
        help
            Enables only (Q35 + ICH9, 2009) ver 1.4 and 1.5 on i386.
    
    config ISAPC
        bool "ISA-only PC"
        depends on i386
        select isapc
        help
            Enables only ISA-PC on i386.

endmenu

menu "Board(s) - (currently only for i386)"
    
    config pc-i440fx-1.5
        bool "pc-i440fx-1.5"
    
    config pc-i440fx-1.4
        bool "pc-i440fx-1.4"

    config pc-1.3
        bool "pc-1.3"
    
    config pc-1.2
        bool "pc-1.2"

    config pc-1.1
        bool "pc-1.1"

    config pc-1.0
        bool "pc-1.0"

    config pc-0.15
        bool "pc-0.15"

    config pc-0.14
        bool "pc-0.14"

    config pc-0.13
        bool "pc-0.13"

    config pc-0.12
        bool "pc-0.12"

    config pc-0.11
        bool "pc-0.11"

    config pc-0.10
        bool "pc-0.10"

    config isapc
        bool "isapc"

    config pc-q35-1.5
        bool "pc-q35-1.5"

    config pc-q35-1.4
        bool "pc-q35-1.4"


endmenu

menu "Onboard Buses - (Demo representation only)"

    config USB
        bool "USB"
        default y
        help
            Enable USB bus.

    config PCI
        bool "PCI"
        default y
        help
            Enable PCI bus. 

    config SERIAL
        bool "Serial"
        default y
        help
            Enable Serial bus.

    config ISA 
        bool "ISA"
        default y
        help
            Enable ISA bus.

    config SCSI
        bool "SCSI"
        default y
        help
            Enable SCSI bus.

    config I2C
        bool "I2C"
        default y
        help
            Enable I2C bus.
    
    config IDE
        bool "IDE"
        default y
        help
            Enable IDE bus.

endmenu

menu "Hardware support - (Demo representation only)"
    
    config GDBSTUB_XML 
        bool "GDBSTUB_XML"
        default y
        help
            Enable GDBSTUB_XML.
    
    config VGA
        bool "VGA"
        default y
        help
            Enable VGA.

    config ISA_MMIO 
        depends on ISA
        bool "ISA_MMIO"
        default y
        help
            Enable ISA MMIO.

    config NAND
        bool "NAND"
        default y
        help
            Enable NAND.

    config ECC
        bool "ECC"
        default y
        help
            Enable ECC.

    config PTIMER
        depends on SERIAL
        bool "SERIAL"
        default y
        help
            Enable PTIMER.

    config SD
        depends on USB
        bool "SD"
        default y
        help
            Enable SD storage.

    config LSI_SCSI
        depends on SCSI
        bool "lsi53c895a scsi controllers"
        default y
        help
            Support boot from qemu-emulated lsi53c895a scsi storage.
    
    config SDHCI
        depends on SD
        bool "SD HCI controllers"
        default y
        help
            Support SD HCI controllers.
    
    config USB_OHCI
        depends on USB
        bool "USB OHCI controllers"
        default y
        help
            Support USB OHCI controllers.
    
    config USB_EHCI
        depends on USB
        bool "USB EHCI controllers"
        default y
        help
            Support USB EHCI controllers.
    
    config USB_MSC
        depends on USB && DRIVES
        bool "USB drives"
        default y
        help
            Support USB BOT (bulk-only transport) disks.
    
    config USB_UAS
        depends on USB && DRIVES
        bool "UAS drives"
        default y
        help
            Support USB UAS (usb attached scsi) disks.
    
    config USB_HUB
        depends on USB
        bool "USB hubs"
        default y
        help
            Support USB hubs.

    config DRIVES
        depends on IDE
        default y
        bool "IDE Drive interface"
        help 
            Support for disk interface.

endmenu
```
